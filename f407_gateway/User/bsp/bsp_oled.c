/* ================================================================
 * SSD1306 OLED 驱动 (I2C, 128x64)
 *   移植自江协科技 4针 I2C 版驱动 (此驱动在该模块上已验证可正常显示)
 *   字体: OLED_F8x16 (8宽 x 16高, 每字 16 字节, 上下两半)
 *   接口: 行(Line 1~4) / 列(Column 1~16) 定位, 直接写屏, 无帧缓冲
 *   底层 I2C: 使用 CubeMX 配置的 I2C1 (PB8/PB9), 经 BSP_I2C1_Write 发送。
 *   仅将江协科技的软件 GPIO 模拟 I2C 替换为 HAL 硬件 I2C, 其余逻辑原样。
 * ================================================================ */

#include <stdint.h>
#include "bsp_oled.h"
#include "bsp_i2c.h"
#include "stm32f4xx_hal.h"
#include "gpio.h"      /* GPIOF / GPIO_PIN_9 (LED0, 低电平亮) */

#define OLED_ADDR   0x3C   /* 7-bit; 江协科技发 0x78 = (0x3C<<1) */

/* I²C 通信失败累计（诊断用）: OLED_Init 末尾据它点亮/熄灭 LED0 */
static uint32_t s_i2c_err = 0;

/* ---- 8x16 字体 (江协科技原版, 内联以省去额外 build 文件) ---- */
static const uint8_t OLED_F8x16[][16] =
{
    0x00,0x00,0x00,0x00,0x00,0x00,0x00,0x00,
    0x00,0x00,0x00,0x00,0x00,0x00,0x00,0x00,//  0
    0x00,0x00,0x00,0xF8,0x00,0x00,0x00,0x00,
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    0x00,0x00,0x00,0x00,0x00,0x00,0x00,0x00,//~ 94
};

/* ---- I2C 底层 (HAL 硬件 I2C 替换江协科技的软件 GPIO 模拟) ---- */
/* 诊断性延时: 江协科技软件模拟 I2C 字节间天然有 GPIO 翻转延时(慢),
   本模块在 F407 硬件 I2C 100kHz 下偶发位翻转(满屏FF测试掩盖, 字符暴露)。
   每次事务后加 1ms, 给 SSD1306 处理时间 + 保证 tBUF 总线空闲, 验证是否时序问题。
   确认有效后再优化: 改微秒级延时 / 仅命令后加 / 或 CubeMX 降 50kHz。 */
static void oled_write_cmd(uint8_t cmd)
{
    uint8_t buf[2] = {0x00, cmd};   /* 0x00 = Co=0, D/C#=0 (命令) */
    if (BSP_I2C1_Write(OLED_ADDR, buf, 2) != HAL_OK) s_i2c_err++;
    HAL_Delay(1);
}

static void oled_write_data(uint8_t data)
{
    uint8_t buf[2] = {0x40, data};  /* 0x40 = Co=0, D/C#=1 (数据) */
    if (BSP_I2C1_Write(OLED_ADDR, buf, 2) != HAL_OK) s_i2c_err++;
    /* 数据流水: 满屏FF测试已证明 SSD1306 接得住连续数据, 不加延时保持快 */
}

/**
  * @brief  设置光标位置 (优化版)
  * @param  Y 页坐标 0~7
  * @param  X 列坐标 0~127
  * @note   3 条命令合并为 1 次 I²C 写入 (4 字节), HAL_Delay 只 1 次。
  *         原版每次 oled_write_cmd 都独立事务 + 1ms 延时, 一字符 2 次 SetCursor ≈ 6ms;
  *         现在 2 次 SetCursor ≈ 2ms + 数据合并发 ≈ 0.9ms → ~3ms/字符 (原来 ~6ms)。
  */
void OLED_SetCursor(uint8_t Y, uint8_t X)
{
    uint8_t buf[4];
    buf[0] = 0x00;                            /* Co=0, D/C#=0 命令流 */
    buf[1] = 0xB0 | Y;                         /* 页地址 */
    buf[2] = 0x10 | ((X & 0xF0) >> 4);         /* 列地址高 4 位 */
    buf[3] = 0x00 | (X & 0x0F);                /* 列地址低 4 位 */
    if (BSP_I2C1_Write(OLED_ADDR, buf, 4) != HAL_OK) s_i2c_err++;
    HAL_Delay(1);                             /*  命令需 SSD1306 处理 */
}

void OLED_Clear(void)
{
    uint8_t i, j;
    /* 优化: 每页 128 字节分 16 次写 (每次 9 字节 = 0x40 + 8 数据),
       依赖 SSD1306 页模式列自动递增 (init 0x20/0x02 已设)。 */
    for (j = 0; j < 8; j++)
    {
        OLED_SetCursor(j, 0);
        for (i = 0; i < 16; i++)   /* 128 / 8 = 16 次 */
        {
            uint8_t buf[9];
            buf[0] = 0x40;
            for (uint8_t k = 0; k < 8; k++) buf[1+k] = 0x00;
            if (BSP_I2C1_Write(OLED_ADDR, buf, 9) != HAL_OK) s_i2c_err++;
        }
    }
}

void OLED_ShowChar(uint8_t Line, uint8_t Column, char Char)
{
    /* 优化: 上下半各 8 字节数据合并为 1 次 I²C 写入 (9 字节),
       依赖列自动递增 → 一次发 8 字节 SSD1306 自动填 8 列。 */
    uint8_t buf[9];

    OLED_SetCursor((Line - 1) * 2, (Column - 1) * 8);     /* 上半起点 */
    buf[0] = 0x40;
    for (uint8_t i = 0; i < 8; i++) buf[1+i] = OLED_F8x16[Char - ' '][i];
    if (BSP_I2C1_Write(OLED_ADDR, buf, 9) != HAL_OK) s_i2c_err++;

    OLED_SetCursor((Line - 1) * 2 + 1, (Column - 1) * 8); /* 下半起点 */
    buf[0] = 0x40;
    for (uint8_t i = 0; i < 8; i++) buf[1+i] = OLED_F8x16[Char - ' '][i + 8];
    if (BSP_I2C1_Write(OLED_ADDR, buf, 9) != HAL_OK) s_i2c_err++;
}

void OLED_ShowString(uint8_t Line, uint8_t Column, char *String)
{
    uint8_t i;
    for (i = 0; String[i] != '\0'; i++)
        OLED_ShowChar(Line, Column + i, String[i]);
}

static uint32_t OLED_Pow(uint32_t X, uint32_t Y)
{
    uint32_t Result = 1;
    while (Y--)
        Result *= X;
    return Result;
}

void OLED_ShowNum(uint8_t Line, uint8_t Column, uint32_t Number, uint8_t Length)
{
    uint8_t i;
    for (i = 0; i < Length; i++)
        OLED_ShowChar(Line, Column + i, Number / OLED_Pow(10, Length - i - 1) % 10 + '0');
}

void OLED_Init(void)
{
    HAL_Delay(200);   /* 上电稳定延时 (江协科技用软件循环, 这里用 HAL_Delay 等效) */

    /* 江协科技 4针 I2C 版原始初始化序列 (该模块验证可用) */
    oled_write_cmd(0xAE);    /* 关闭显示 */
    oled_write_cmd(0x20); oled_write_cmd(0x02);   /* 页地址模式 (显式, 兼容热复位) */
    oled_write_cmd(0xD5); oled_write_cmd(0x80);   /* 时钟分频 */
    oled_write_cmd(0xA8); oled_write_cmd(0x3F);   /* 多路复用率 64 */
    oled_write_cmd(0xD3); oled_write_cmd(0x00);   /* 显示偏移 0 */
    oled_write_cmd(0x40);                         /* 显示开始行 0 */
    oled_write_cmd(0xA1);                         /* 左右方向正常 */
    oled_write_cmd(0xC8);                         /* 上下方向正常 */
    oled_write_cmd(0xDA); oled_write_cmd(0x12);   /* COM 引脚配置 */
    oled_write_cmd(0x81); oled_write_cmd(0xCF);   /* 对比度 */
    oled_write_cmd(0xD9); oled_write_cmd(0xF1);   /* 预充电 (标准值) */
    oled_write_cmd(0xDB); oled_write_cmd(0x30);   /* VCOMH (标准值) */
    oled_write_cmd(0xA4);                         /* 显示内容来自 RAM */
    oled_write_cmd(0xA6);                         /* 正常显示 */
    oled_write_cmd(0x8D); oled_write_cmd(0x14);   /* 电荷泵开 */
    oled_write_cmd(0xAF);                         /* 开启显示 */

    OLED_Clear();

    /* 诊断: I²C 通信失败过多 → LED0(PF9) 保持灭(低电平亮=灭);
       正常 → 保持亮。用于区分"OLED 黑屏是 I²C 通信问题还是渲染问题"。
       注意: alert_task 只在收到事件时才碰 LED0, 平时保持这里的状态。 */
    if (s_i2c_err > 10)
        HAL_GPIO_WritePin(GPIOF, GPIO_PIN_9, GPIO_PIN_SET);   /* 灭 = I²C 失败 */

    /* 隔离测试: 调度器启动前直接显示固定内容(不依赖 ui_task)。
       上电若能看到这行字 → OLED 驱动/硬件 OK, 黑屏根因在 ui_task;
       仍黑 → OLED init/驱动问题。ui_task 跑起来后 ~0.2s 会覆盖成菜单。 */
    OLED_ShowString(1, 1, "F407 GW");
    OLED_ShowString(2, 1, "TEST 1234");
}
